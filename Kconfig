## drivers/iqs7211e/dts/bindings/zmk,input-processor-responsive-scroll.yaml
```yaml
description: Scale wheel input while emitting the first step immediately

compatible: "zmk,input-processor-responsive-scroll"

include: ip_two_param.yaml

properties:
  reset-after-ms:
    type: int
    default: 150
    description: Idle time that starts a new scroll gesture
```

## drivers/iqs7211e/dts/bindings/zmk,input-processor-scroll-keys.yaml
```yaml
description: Convert vertical wheel steps to key taps

compatible: "zmk,input-processor-scroll-keys"

include: ip_zero_param.yaml

properties:
  bindings:
    type: phandle-array
    required: true
    description: Positive wheel binding followed by negative wheel binding
```

## drivers/iqs7211e/dts/bindings/zmk,input-processor-trackpad-intercept.yaml
```yaml
description: Discard horizontal and double-tap events and keep each scroll burst on one layer

compatible: "zmk,input-processor-trackpad-intercept"

include: ip_zero_param.yaml

properties:
  zoom-layer:
    type: int
    required: true
  volume-layer:
    type: int
    required: true
  idle-ms:
    type: int
    required: true
    description: Gap after which the next wheel event begins a new scroll burst
```

## drivers/iqs7211e/dts/bindings/zmk,input-processor-trackpad-transition.yaml
```yaml
description: Keep trackpad taps on one layer and discard input during layer transitions

compatible: "zmk,input-processor-trackpad-transition"

include: ip_zero_param.yaml

properties:
  bindings:
    type: phandle-array
    required: true
    description: Tap bindings for base, zoom and volume modes, in that order
  zoom-layer:
    type: int
    required: true
  volume-layer:
    type: int
    required: true
  zoom-key-position:
    type: int
    required: true
    description: Position of the hold-tap key that enables the zoom layer
  volume-key-position:
    type: int
    required: true
    description: Position of the hold-tap key that enables the volume layer
  transition-guard-ms:
    type: int
    default: 100
```
